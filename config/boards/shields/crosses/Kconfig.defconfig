## config/boards/shields/crosses/Kconfig.defconfig
```kconfig
if SHIELD_CROSSES_RIGHT

config ZMK_KEYBOARD_NAME
	default "Crosses"

config ZMK_SPLIT_ROLE_CENTRAL
	default y

config ZMK_SPLIT_BLE_ROLE_CENTRAL
	default y

endif

if SHIELD_CROSSES_LEFT || SHIELD_CROSSES_RIGHT

config ZMK_SPLIT
	default y

config ZMK_STUDIO_RPC
	default y if ZMK_STUDIO

if ZMK_DISPLAY

  config I2C
      default y

  config SSD1306
      default y

endif # ZMK_DISPLAY

endif
```

## config/west.yml
```yaml
manifest:
  remotes:
    - name: zmkfirmware
      url-base: https://github.com/zmkfirmware
    - name: inorichi
      url-base: https://github.com/inorichi
    - name: maatthc
      url-base: https://github.com/maatthc
  projects:
    - name: zmk
      remote: zmkfirmware
      revision: v0.3.0
      import: app/west.yml
    - name: zmk-pmw3610-driver
      remote: inorichi
      revision: main
    - name: zmk-feature-appcompanion
      remote: maatthc
      revision: main
  self:
    path: config
```

## modules/zmk-layer-status-hid/Kconfig
```kconfig
config ZMK_LAYER_STATUS_HID
    bool "Enable layer status HID reporting for Keyboard layers app companion"
    default y
    help
        Enables sending layer state changes via USB HID raw reports
        compatible with the Keyboard layers app companion.
```
